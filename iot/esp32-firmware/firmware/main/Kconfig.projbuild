## iot/esp32-firmware/firmware/main/Kconfig.projbuild
```kconfig
menu "MCU Telemetry Demo"

    config WIFI_SSID
        string "Wi-Fi SSID"
        default "Wokwi-GUEST"
        help
            Wokwi provides the open "Wokwi-GUEST" AP with internet access,
            which reaches the public test.mosquitto.org broker.

    config WIFI_PASSWORD
        string "Wi-Fi password"
        default ""

    config MQTT_BROKER_URI
        string "MQTT broker URI"
        default "mqtt://test.mosquitto.org:1883"
        help
            Public broker for the Wokwi path (no paid Wokwi gateway needed).
            For real hardware on your LAN, point this at your own broker.

    config MQTT_TOPIC_PREFIX
        string "MQTT topic prefix"
        default "scout/mcu"
        help
            The device publishes to <prefix>/<device_id>/telemetry and sets a
            Last Will on <prefix>/<device_id>/offline. On the shared public
            broker, use a unique prefix (e.g. scout-demo-<uuid>/mcu) so runs
            do not collide, and set the same prefix on the sme-bridge.

    config DEVICE_ID
        string "Device ID"
        default "esp32-dev-01"

    config DEVICE_MODEL
        string "Device model"
        default "esp32-s3-devkitc"

    config FIRMWARE_VERSION
        string "Firmware version"
        default "0.1.0"

    config FIRMWARE_CHANNEL
        string "Firmware release channel"
        default "dev"

    config FLEET_ID
        string "Fleet ID"
        default "fleet-demo"

    config FLEET_TENANT
        string "Fleet tenant"
        default "acme"

    config PUBLISH_INTERVAL_S
        int "Publish interval (seconds)"
        default 10
        range 1 3600

endmenu
```

## iot/esp32-firmware/firmware/sdkconfig.defaults
```kconfig
# Defaults applied on a fresh `idf.py build`. The generated sdkconfig is
# gitignored; tweak through `idf.py menuconfig` or by editing this file.

# Target: ESP32-S3 (has the internal temperature sensor the v5.x driver reads;
# the classic WROOM-32 does not expose it through driver/temperature_sensor.h).
CONFIG_IDF_TARGET="esp32s3"

# Give app_main room for the cJSON build + TLS-capable MQTT stack.
CONFIG_ESP_MAIN_TASK_STACK_SIZE=8192

# Enable MQTT 5.0 in esp-mqtt (Last Will, user properties).
CONFIG_MQTT_PROTOCOL_5=y
```
